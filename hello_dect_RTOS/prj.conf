## CMakeLists.txt
```
#
# Copyright (c) 2024 Nordic Semiconductor
#
# SPDX-License-Identifier: LicenseRef-Nordic-5-Clause
#

cmake_minimum_required(VERSION 3.20.0)

find_package(Zephyr REQUIRED HINTS $ENV{ZEPHYR_BASE})
project(hello_dect_RTOS)

target_sources(app PRIVATE 
    src/main.c
    src/dect_nr.c
    src/i2c.c)
```

## prj.conf
```kconfig
CONFIG_NRF_MODEM_LIB=y

CONFIG_MODEM_ANTENNA=n

CONFIG_NRF_MODEM_LINK_BINARY_DECT_PHY=y
CONFIG_HWINFO=y

CONFIG_LOG=y

CONFIG_I2C=y

CONFIG_CBPRINTF_FP_SUPPORT=y


CONFIG_BUILD_WITH_TFM=n
CONFIG_TFM_PROFILE_TYPE_MINIMAL=y
CONFIG_TFM_ISOLATION_LEVEL=1
```

## src/main.c
```c
/*
 * Copyright (c) 2024 Nordic Semiconductor ASA
 * Copyright (c) 2017 Linaro Limited // Added for multi-threading concepts
 *
 * SPDX-License-Identifier: LicenseRef-Nordic-5-Clause OR Apache-2.0
 */
#include <string.h>
#include <stdio.h>
#include <zephyr/kernel.h>
#include <zephyr/logging/log.h>
#include <modem/nrf_modem_lib.h>
#include <zephyr/drivers/hwinfo.h>

#include "main.h"
#include "i2c.h"
#include "dect_nr.h"

LOG_MODULE_REGISTER(app);

BUILD_ASSERT(CONFIG_CARRIER, "Carrier must be configured according to local regulations");

/* Thread stack sizes and priorities */
#define SENSOR_STACKSIZE        1024
#define DECT_STACKSIZE          2048 
#define SENSOR_PRIORITY         7
#define DECT_PRIORITY           5

/* Shared Data */
float g_current_temperature_c = 0.0f;
K_MUTEX_DEFINE(temp_mutex); 
K_SEM_DEFINE(operation_sem, 0, 1);

/* Global Variables */
static bool exit_app;
uint16_t device_id;

int main(void)
{
    int err;

    LOG_INF("DECT NR+ PHY Multi-Threaded Sample Started");

    /* Initialize Modem Library */
    err = nrf_modem_lib_init();
    if (err) {
        LOG_ERR("Modem library init failed, err %d", err);
        return err;
    }

    /* Initialize I2C Sensor */
    err = bme280_init();
    if (err) {
        LOG_ERR("BME280 initialization failed, err %d", err);
        // Decide if this is fatal or if we continue
    }

    /* Initialize DECT PHY */
    err = dect_phy_init();
    if (err) {
        LOG_ERR("DECT PHY initialization failed, err %d", err);
        // nrf_modem_lib_shutdown(); // Attempt cleanup
        return err;
    }

    /* Get Device ID */
    uint8_t dev_id_buf[sizeof(device_id)];
    err = hwinfo_get_device_id(dev_id_buf, sizeof(dev_id_buf));
    if (err < 0) {
        LOG_ERR("Failed to get device ID, err %d", err);
        device_id = 0xFFFF; // Assign placeholder ID
    } else {
        memcpy(&device_id, dev_id_buf, sizeof(device_id));
    }

    LOG_INF("DECT NR+ PHY initialized, Device ID: %u (0x%04X)", device_id, device_id);
    LOG_INF("Starting worker threads...");
    
    return 0;
}

/* Thread Definitions */
K_THREAD_DEFINE(sensor_thread_id, SENSOR_STACKSIZE, sensor_thread_entry, NULL, NULL, NULL,
                SENSOR_PRIORITY, 0, 0);

K_THREAD_DEFINE(dect_thread_id, DECT_STACKSIZE, dect_thread_entry, NULL, NULL, NULL,
                DECT_PRIORITY, 0, 0);
```

## src/dect_nr.c
```c
/*
 * Copyright (c) 2024 Nordic Semiconductor ASA
 *
 * SPDX-License-Identifier: LicenseRef-Nordic-5-Clause OR Apache-2.0
 */
#include <string.h>
#include <stdio.h>
#include <zephyr/kernel.h>
#include <zephyr/logging/log.h>
#include <nrf_modem_dect_phy.h>
#include "main.h"
#include "dect_nr.h"

LOG_MODULE_REGISTER(dect);

#define DATA_LEN_MAX 32

/* Dect PHY callbacks struct */
static struct nrf_modem_dect_phy_callbacks dect_phy_callbacks = {
    .init = init,
    .deinit = deinit,
    .op_complete = op_complete,
    .rx_stop = rx_stop,
    .pcc = pcc,
    .pcc_crc_err = pcc_crc_err,
    .pdc = pdc,
    .pdc_crc_err = pdc_crc_err,
    .rssi = rssi,
    .link_config = link_config,
    .time_get = time_get,
    .capability_get = capability_get,
    .stf_cover_seq_control = stf_cover_seq_control,
};

/* Dect PHY init parameters */
static struct nrf_modem_dect_phy_init_params dect_phy_init_params = {
    .harq_rx_expiry_time_us = 5000000,
    .harq_rx_process_count = 4,
};

/* Global Variables */
static bool exit_app; // Shared with main.c through callback

/* Initialize DECT PHY */
int dect_phy_init(void)
{
    int err;

    err = nrf_modem_dect_phy_callback_set(&dect_phy_callbacks);
    if (err) {
        LOG_ERR("nrf_modem_dect_phy_callback_set failed, err %d", err);
        return err;
    }

    err = nrf_modem_dect_phy_init(&dect_phy_init_params);
    if (err) {
        LOG_ERR("nrf_modem_dect_phy_init failed, err %d", err);
        return err;
    }

    /* Wait for the init callback to complete */
    err = k_sem_take(&operation_sem, K_SECONDS(10));
    if (err != 0) {
        LOG_ERR("Timeout waiting for DECT PHY init complete!");
        return -ETIMEDOUT;
    }
    if (exit_app) {
        LOG_ERR("DECT PHY init failed in callback.");
        return -EIO;
    }

    return 0;
}

/* DECT callbacks implementation */
void init(const uint64_t *time, int16_t temp, enum nrf_modem_dect_phy_err err,
         const struct nrf_modem_dect_phy_modem_cfg *cfg)
{
    if (err) {
        LOG_ERR("Init failed, err %d", err);
        exit_app = true;
    }
    k_sem_give(&operation_sem);
}

void deinit(const uint64_t *time, enum nrf_modem_dect_phy_err err)
{
    if (err) {
        LOG_ERR("Deinit failed, err %d", err);
    }
    k_sem_give(&operation_sem);
}

void op_complete(const uint64_t *time, int16_t temperature,
                enum nrf_modem_dect_phy_err err, uint32_t handle)
{
    LOG_DBG("op_complete cb time %"PRIu64" status %d handle %u", *time, err, handle);
    if (err) {
        LOG_WRN("Operation %u failed with err %d", handle, err);
    }
    k_sem_give(&operation_sem);
}

void rx_stop(const uint64_t *time, enum nrf_modem_dect_phy_err err, uint32_t handle)
{
    LOG_DBG("rx_stop cb time %"PRIu64" status %d handle %u", *time, err, handle);
    if (err && err != NRF_MODEM_DECT_PHY_ERR_RX_STOPPED) {
        LOG_WRN("rx_stop failed with err %d", err);
    }
}

void pcc(const uint64_t *time,
         const struct nrf_modem_dect_phy_rx_pcc_status *status,
         const union nrf_modem_dect_phy_hdr *hdr)
{
    struct phy_ctrl_field_common *header = (struct phy_ctrl_field_common *)hdr->type_1;
    LOG_INF("PCC from device ID %d",
            header->transmitter_id_hi << 8 | header->transmitter_id_lo);
}

void pcc_crc_err(const uint64_t *time,
                const struct nrf_modem_dect_phy_rx_pcc_crc_failure *crc_failure)
{
    LOG_WRN("PCC CRC Error cb time %"PRIu64"", *time);
}

void pdc(const uint64_t *time,
         const struct nrf_modem_dect_phy_rx_pdc_status *status,
         const void *data, uint32_t len)
{
    LOG_INF("Received data (RSSI: %d.%d): %.*s",
            (status->rssi_2 / 2), (status->rssi_2 & 0b1) * 5, len, (char *)data);
}

void pdc_crc_err(const uint64_t *time, 
                const struct nrf_modem_dect_phy_rx_pdc_crc_failure *crc_failure)
{
    LOG_WRN("PDC CRC Error cb time %"PRIu64"", *time);
}

void rssi(const uint64_t *time, const struct nrf_modem_dect_phy_rssi_meas *status)
{
    LOG_DBG("rssi cb time %"PRIu64" carrier %d", *time, status->carrier);
}

void link_config(const uint64_t *time, enum nrf_modem_dect_phy_err err)
{
    LOG_DBG("link_config cb time %"PRIu64" status %d", *time, err);
}

void time_get(const uint64_t *time, enum nrf_modem_dect_phy_err err)
{
    LOG_DBG("time_get cb time %"PRIu64" status %d", *time, err);
}

void capability_get(const uint64_t *time, enum nrf_modem_dect_phy_err err,
                   const struct nrf_modem_dect_phy_capability *capability)
{
    LOG_DBG("capability_get cb time %"PRIu64" status %d", *time, err);
}

void stf_cover_seq_control(const uint64_t *time, enum nrf_modem_dect_phy_err err)
{
    LOG_WRN("Unexpectedly in %s\n", (__func__));
}

/* DECT Transmit/Receive Functions */
int transmit(uint32_t handle, void *data, size_t data_len)
{
    int err;

    struct phy_ctrl_field_common header = {
        .header_format = 0x0,
        .packet_length_type = 0x0,
        .packet_length = 0x01,
        .short_network_id = (CONFIG_NETWORK_ID & 0xff),
        .transmitter_id_hi = (device_id >> 8),
        .transmitter_id_lo = (device_id & 0xff),
        .transmit_power = CONFIG_TX_POWER,
        .reserved = 0,
        .df_mcs = CONFIG_MCS,
    };

    struct nrf_modem_dect_phy_tx_params tx_op_params = {
        .start_time = 0,
        .handle = handle,
        .network_id = CONFIG_NETWORK_ID,
        .phy_type = 0,
        .lbt_rssi_threshold_max = 0,
        .carrier = CONFIG_CARRIER,
        .lbt_period = NRF_MODEM_DECT_LBT_PERIOD_MAX,
        .phy_header = (union nrf_modem_dect_phy_hdr *)&header,
        .data = data,
        .data_size = data_len,
    };

    err = nrf_modem_dect_phy_tx(&tx_op_params);
    if (err != 0) {
        LOG_ERR("nrf_modem_dect_phy_tx failed, err %d", err);
        return err;
    }
    LOG_DBG("TX submitted with handle %u", handle);
    return 0;
}

int receive(uint32_t handle)
{
    int err;

    struct nrf_modem_dect_phy_rx_params rx_op_params = {
        .start_time = 0,
        .handle = handle,
        .network_id = CONFIG_NETWORK_ID,
        .mode = NRF_MODEM_DECT_PHY_RX_MODE_CONTINUOUS,
        .rssi_interval = NRF_MODEM_DECT_PHY_RSSI_INTERVAL_OFF,
        .link_id = NRF_MODEM_DECT_PHY_LINK_UNSPECIFIED,
        .rssi_level = -60,
        .carrier = CONFIG_CARRIER,
        .duration = (uint64_t)CONFIG_RX_PERIOD_S * MSEC_PER_SEC *
                   NRF_MODEM_DECT_MODEM_TIME_TICK_RATE_KHZ,
        .filter.short_network_id = CONFIG_NETWORK_ID & 0xff,
        .filter.is_short_network_id_used = 1,
        .filter.receiver_identity = 0,
    };

    err = nrf_modem_dect_phy_rx(&rx_op_params);
    if (err != 0) {
        LOG_ERR("nrf_modem_dect_phy_rx failed, err %d", err);
        return err;
    }
    LOG_DBG("RX submitted with handle %u for %u s", handle, CONFIG_RX_PERIOD_S);
    return 0;
}

/* DECT Thread Entry Function */
void dect_thread_entry(void *p1, void *p2, void *p3)
{
    int err;
    uint32_t tx_handle = 0;
    uint32_t rx_handle = 1;
    uint8_t tx_buf[DATA_LEN_MAX];
    size_t tx_len;
    float local_temperature_c;

    LOG_INF("DECT thread started");

    while (1) {
        /* Read Shared Temperature Variable */
        err = k_mutex_lock(&temp_mutex, K_MSEC(100));
        if (err == 0) {
            local_temperature_c = g_current_temperature_c;
            k_mutex_unlock(&temp_mutex);
        } else {
            LOG_WRN("Could not lock temp mutex in DECT thread, using last known temp: %.2f", 
                   local_temperature_c);
        }

        /* Format message for transmission */
        tx_len = snprintf(tx_buf, sizeof(tx_buf), "T:%.2fC", local_temperature_c);
        if (tx_len >= sizeof(tx_buf)) {
            LOG_WRN("Temperature string truncated!");
            tx_len = sizeof(tx_buf) - 1;
        }

        LOG_INF("Transmitting: %s", tx_buf);

        /* Transmit message */
        err = transmit(tx_handle, tx_buf, tx_len);
        if (err) {
            LOG_ERR("Transmission failed, err %d", err);
            k_msleep(1000);
            continue;
        }

        /* Wait for TX operation to complete */
        err = k_sem_take(&operation_sem, K_SECONDS(5));
        if (err != 0) {
            LOG_ERR("Timeout waiting for TX complete (handle %u)", tx_handle);
        } else {
            LOG_DBG("TX complete confirmation received (handle %u)", tx_handle);
        }

        /* Receive messages for configured duration */
        err = receive(rx_handle);
        if (err) {
            LOG_ERR("Starting reception failed, err %d", err);
            k_msleep(1000);
            continue;
        }

        /* Wait for RX operation to complete */
        err = k_sem_take(&operation_sem, K_SECONDS(CONFIG_RX_PERIOD_S + 2));
        if (err != 0) {
            LOG_ERR("Timeout waiting for RX complete (handle %u)", rx_handle);
        } else {
            LOG_DBG("RX complete confirmation received (handle %u)", rx_handle);
        }
    }
}
```

## src/dect_nr.h
```c
#ifndef DECT_NR_H
#define DECT_NR_H

#include <nrf_modem_dect_phy.h>

/* DECT Function declarations */
int dect_phy_init(void);
int transmit(uint32_t handle, void *data, size_t data_len);
int receive(uint32_t handle);
void dect_thread_entry(void *p1, void *p2, void *p3);

/* Header type 1 */
struct phy_ctrl_field_common {
    uint32_t packet_length : 4;
    uint32_t packet_length_type : 1;
    uint32_t header_format : 3;
    uint32_t short_network_id : 8;
    uint32_t transmitter_id_hi : 8;
    uint32_t transmitter_id_lo : 8;
    uint32_t df_mcs : 3;
    uint32_t reserved : 1;
    uint32_t transmit_power : 4;
    uint32_t pad : 24;
};

/* Callback declarations */
void init(const uint64_t *time, int16_t temp, 
          enum nrf_modem_dect_phy_err err,
          const struct nrf_modem_dect_phy_modem_cfg *cfg);

void deinit(const uint64_t *time, enum nrf_modem_dect_phy_err err);

void op_complete(const uint64_t *time, int16_t temperature,
                enum nrf_modem_dect_phy_err err, uint32_t handle);

void rx_stop(const uint64_t *time, enum nrf_modem_dect_phy_err err, uint32_t handle);

void pcc(const uint64_t *time,
         const struct nrf_modem_dect_phy_rx_pcc_status *status,
         const union nrf_modem_dect_phy_hdr *hdr);

void pcc_crc_err(const uint64_t *time,
                const struct nrf_modem_dect_phy_rx_pcc_crc_failure *crc_failure);

void pdc(const uint64_t *time,
         const struct nrf_modem_dect_phy_rx_pdc_status *status,
         const void *data, uint32_t len);

void pdc_crc_err(const uint64_t *time, 
                const struct nrf_modem_dect_phy_rx_pdc_crc_failure *crc_failure);

void rssi(const uint64_t *time, const struct nrf_modem_dect_phy_rssi_meas *status);

void link_config(const uint64_t *time, enum nrf_modem_dect_phy_err err);

void time_get(const uint64_t *time, enum nrf_modem_dect_phy_err err);

void capability_get(const uint64_t *time, enum nrf_modem_dect_phy_err err,
                   const struct nrf_modem_dect_phy_capability *capability);

void stf_cover_seq_control(const uint64_t *time, enum nrf_modem_dect_phy_err err);

#endif /* DECT_NR_H */
```

## src/i2c.c
```c
/*
 * Copyright (c) 2024 Nordic Semiconductor ASA
 *
 * SPDX-License-Identifier: LicenseRef-Nordic-5-Clause OR Apache-2.0
 */
#include <string.h>
#include <stdio.h>
#include <zephyr/kernel.h>
#include <zephyr/logging/log.h>
#include "main.h"
#include "i2c.h"
#include "dect_nr.h"

LOG_MODULE_REGISTER(i2c);

/* BME280 register addresses */
#define CTRLMEAS 0xF4
#define CALIB00  0x88
#define ID       0xD0
#define TEMPMSB  0xFA
#define CHIP_ID  0x60
#define SENSOR_CONFIG_VALUE 0x93
#define SENSOR_READ_INTERVAL_MS 2000

/* Global variables */
struct bme280_data bmedata;
const struct i2c_dt_spec dev_i2c = I2C_DT_SPEC_GET(DT_NODELABEL(mysensor));

/* Initialize BME280 */
int bme280_init(void)
{
    int err;

    if (!device_is_ready(dev_i2c.bus)) {
        LOG_ERR("I2C bus %s is not ready!", dev_i2c.bus->name);
        return -ENODEV;
    }
    LOG_INF("I2C device %s ready", dev_i2c.name);

    /* Check BME280 Chip ID */
    uint8_t chip_id_reg[] = {ID};
    uint8_t chip_id_val = 0;
    err = i2c_write_read_dt(&dev_i2c, chip_id_reg, sizeof(chip_id_reg), 
                           &chip_id_val, sizeof(chip_id_val));
    if (err) {
        LOG_ERR("Failed to read BME Chip ID, err: %d", err);
        return err; 
    } else if (chip_id_val != CHIP_ID) {
        LOG_WRN("BME Chip ID mismatch! Expected 0x%02X, Got 0x%02X", CHIP_ID, chip_id_val);
        return -ENODEV;
    } else {
        LOG_INF("BME Chip ID OK (0x%02X)", chip_id_val);
    }

    /* Get BME280 Calibration Data */
    bme_calibrationdata();

    /* Configure BME280 Sensor */
    uint8_t sensor_config[] = {CTRLMEAS, SENSOR_CONFIG_VALUE};
    err = i2c_write_dt(&dev_i2c, sensor_config, sizeof(sensor_config));
    if (err) {
        LOG_ERR("Failed to write BME config, err: %d", err);
        return err;
    } else {
        LOG_INF("BME configured with value 0x%02X to reg 0x%02X", 
               SENSOR_CONFIG_VALUE, CTRLMEAS);
    }

    return 0;
}

/* Get calibration data */
void bme_calibrationdata(void)
{
    uint8_t values[6];
    int ret = i2c_burst_read_dt(&dev_i2c, CALIB00, values, 6);

    if (ret != 0) {
        LOG_ERR("Failed to read BME calibration data, err %d", ret);
        return;
    }

    bmedata.dig_t1 = ((uint16_t)values[1]) << 8 | values[0];
    bmedata.dig_t2 = ((int16_t)values[3]) << 8 | values[2];
    bmedata.dig_t3 = ((int16_t)values[5]) << 8 | values[4];
    LOG_INF("BME T1: %u, T2: %d, T3: %d", 
           bmedata.dig_t1, bmedata.dig_t2, bmedata.dig_t3);
}

/* Compensate temperature */
int32_t bme280_compensate_temp(struct bme280_data *data, int32_t adc_temp)
{
    int32_t var1, var2;

    var1 = (((adc_temp >> 3) - ((int32_t)data->dig_t1 << 1)) * ((int32_t)data->dig_t2)) >> 11;
    var2 = (((((adc_temp >> 4) - ((int32_t)data->dig_t1)) *
              ((adc_temp >> 4) - ((int32_t)data->dig_t1))) >> 12) *
            ((int32_t)data->dig_t3)) >> 14;

    return ((var1 + var2) * 5 + 128) >> 8; // Returns temperature in DegC * 100
}

/* Sensor Thread Entry Function */
void sensor_thread_entry(void *p1, void *p2, void *p3)
{
    int ret;
    uint8_t temp_val[3] = {0};
    int32_t adc_temp;
    int32_t comp_temp;
    float temperature_c;

    LOG_INF("Sensor thread started");

    while (1) {
        /* Read raw temperature data */
        ret = i2c_burst_read_dt(&dev_i2c, TEMPMSB, temp_val, 3);
        if (ret != 0) {
            LOG_ERR("Failed to read temperature register, err %d", ret);
            k_msleep(SENSOR_READ_INTERVAL_MS);
            continue;
        }

        /* Combine raw data */
        adc_temp = (temp_val[0] << 12) | (temp_val[1] << 4) | ((temp_val[2] >> 4) & 0x0F);

        /* Compensate temperature */
        comp_temp = bme280_compensate_temp(&bmedata, adc_temp);
        temperature_c = (float)comp_temp / 100.0f;

        /* Update Shared Temperature Variable */
        ret = k_mutex_lock(&temp_mutex, K_MSEC(100));
        if (ret == 0) {
            g_current_temperature_c = temperature_c;
            k_mutex_unlock(&temp_mutex);
            LOG_INF("Sensor Read: %.2f C", temperature_c);
        } else {
            LOG_WRN("Could not lock temp mutex in sensor thread");
        }

        /* Wait before next reading */
        k_msleep(SENSOR_READ_INTERVAL_MS);
    }
}
```

## src/i2c.h
```c
#ifndef I2C_H
#define I2C_H

#include <zephyr/device.h>
#include <zephyr/devicetree.h>
#include <zephyr/drivers/i2c.h>

/* BME280 Data structure */
struct bme280_data {
    uint16_t dig_t1;
    int16_t dig_t2;
    int16_t dig_t3;
};

/* Function declarations */
int bme280_init(void);
void bme_calibrationdata(void);
int32_t bme280_compensate_temp(struct bme280_data *data, int32_t adc_temp);
void sensor_thread_entry(void *p1, void *p2, void *p3);

/* External declarations */
extern struct bme280_data bmedata;
extern const struct i2c_dt_spec dev_i2c;

#endif /* I2C_H */
```

## src/main.h
```c
#ifndef MAIN_H
#define MAIN_H

#include <zephyr/kernel.h>
#include <nrf_modem_dect_phy.h>

/* External declarations for global variables/resources used across files */
extern struct k_sem operation_sem;
extern struct k_mutex temp_mutex;
extern float g_current_temperature_c;
extern uint16_t device_id;

/* Thread entry point declarations */
void sensor_thread_entry(void *p1, void *p2, void *p3);
void dect_thread_entry(void *p1, void *p2, void *p3);

#endif /* MAIN_H */
```
